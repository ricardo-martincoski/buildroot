## support/scripts/check-package-example/package/package1/Config.in
```kconfig
config BR2_PACKAGE_PACKAGE1
	select BR2_PACKAGE_LIBEVENT
	bool "pAcKaGe"
	depends on BR2_USE_MMU
	select BR2_PACKAGE_NCURSES
	depends on BR2_USE_WCHAR
	help
	  package1 is a bad stylized package. Its only purpose is to exemplify
          common style mistakes
	some more help text but no url

if BR2_PACKAGE_PACKAGE1
 config BR2_PACKAGE_PACKAGE1_OPTION
        bool "package1 option"
        depends on BR2_USE_MMU
        select BR2_PACKAGE_GETTEXT if BR2_NEEDS_GETTEXT_IF_LOCALE
        help
	  This paragraph is properly wrapped. Since a tab counts as 8
	  spaces and the help text must be wrapped at column 72, only 62
	  characters for the text itself are expect per line.


	  Another paragraph. - But this time we cross the column 72 by 1.
	 wrong_line_with_single_word
	  http://www.example.com/ urls do not have spaces and this line is too long.

	  http://www.example.com/folder/even_long_url_should_not_be_wrapped

config BR2_PACKAGE_PACKAGE1_OPTION2
	string "option2"
	default "aarch64-unknown-linux-gnu" \
		if BR2_aarch64 || BR2_aarch64_eb

config BR2_PACKAGE_PACKAGE1_OPTION3
	string "option4"
	default "value" \
                if BR2_aarch64
endif

comment "package1 needs a toolchain w/ locale"
        depends on BR2_USE_MMU
	depends on BR2_USE_WCHAR
```
